## main/Kconfig.projbuild
```kconfig
menu "Liquid level gauge Configuration"

    orsource "$IDF_PATH/examples/common_components/env_caps/$IDF_TARGET/Kconfig.env_caps"

    config LED_GPIO
        int "LED GPIO number"
        range ENV_GPIO_RANGE_MIN ENV_GPIO_OUT_RANGE_MAX
        default 15
        help
            GPIO number (IOxx) for the light/LED.

    config BUTTON_ZIGBEE_CONNECT_PIN
        int "GPIO number for Zigbee connect button"
        range ENV_GPIO_RANGE_MIN ENV_GPIO_OUT_RANGE_MAX
        default 9
        help
            GPIO number (IOxx) for the button to scan and join Zigbee network.

    config ESP_SLEEP_WAKEUP_TIMER
        int "Wakeup from deep sleep period in ms"
        range 10 3600000
        default 10000

    config CLOSURE_PIN_1
        int "Contact number 1 for check closure"
        range ENV_GPIO_RANGE_MIN ENV_GPIO_OUT_RANGE_MAX
        default 0

    config CLOSURE_PIN_2
        int "Contact number 2 for check closure"
        range ENV_GPIO_RANGE_MIN ENV_GPIO_OUT_RANGE_MAX
        default 1

    config POTENTIOMETER_PIN_1
        int "Contact number 1 for meter potentiometer"
        range ENV_GPIO_RANGE_MIN ENV_GPIO_OUT_RANGE_MAX
        default 2

endmenu
```
